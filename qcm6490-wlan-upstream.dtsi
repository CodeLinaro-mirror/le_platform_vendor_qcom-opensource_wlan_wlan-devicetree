// SPDX-License-Identifier: BSD-3-Clause
/*
 * Copyright (c) 2024 Qualcomm Innovation Center, Inc. All rights reserved.
 */
&wifi {
       memory-region = <&wlan_fw_mem>, <&wlan_ce_mem>;
       status = "okay";
};
